## conf/layer.conf
```bitbake
# We have a conf and classes directory, append to BBPATH
BBPATH .= ":${LAYERDIR}"

# We have a recipes directory containing .bb and .bbappend files, add to BBFILES
BBFILES += "${LAYERDIR}/recipes-*/*/*.bb \
            ${LAYERDIR}/recipes-*/*/*.bbappend"

BBFILE_COLLECTIONS += "meta-v2x"
BBFILE_PATTERN_meta-v2x := "^${LAYERDIR}/"
BBFILE_PRIORITY_meta-v2x = "6"

LAYERSERIES_COMPAT_meta-v2x = "kirkstone"
```
